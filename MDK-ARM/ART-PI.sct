; *************************************************************
; *** Scatter-Loading Description File generated by uVision ***
; *************************************************************

LR_IROM1 0x08000000 0x00100000  {    ; load region size_region
  ER_IROM1 0x08000000 0x00100000  {  ; load address = execution address
   *.o (RESET, +First)
   *(InRoot$$Sections)
   .ANY (+RO)
   .ANY (+XO)
    stm32h7xx_it.o (+RO)
    stm32h7xx_hal_msp.o (+RO)
	gpio.o (+RO)
    main.o (+RO)
    w25qxx.o (+RO)
    quadspi.o (+RO)
    stm32h7xx_hal_qspi.o (+RO)
    stm32h7xx_hal.o (+RO)
    stm32h7xx_hal_cortex.o (+RO)
    stm32h7xx_hal_pwr_ex.o (+RO)
    stm32h7xx_hal_pwr.o (+RO)
    stm32h7xx_hal_gpio.o (+RO)
    stm32h7xx_hal_flash_ex.o (+RO)
    stm32h7xx_hal_flash.o (+RO)
    stm32h7xx_hal_rcc.o (+RO)
    stm32h7xx_hal_rcc_ex.o (+RO)
	system_stm32h7xx.o (+RO)
	stm32h7xx_hal_sdram.o (+RO)
	stm32h7xx_ll_fmc.o (+RO)
	fmc.o (+RO)
    startup_stm32h750xx.o (+RO)
    bsp_driver_sd.o (+RO)
    sd_diskio.o (+RO)
    fatfs.o (+RO)
    tlsf.o (+RO)
    ethernetif.o (+RO)
    context_rvds.o (+RO)
    board.o (+RO)
    cpuport.o (+RO)
    cpu_cache.o (+RO)
    clock.o (+RO)
    components.o (+RO)
    cpu.o (+RO)
    idle.o (+RO)
    ipc.o (+RO)
    irq.o (+RO)
    kservice.o (+RO)
    memheap.o (+RO)
    mempool.o (+RO)
    object.o (+RO)
    scheduler.o (+RO)
    slab.o (+RO)
    thread.o (+RO)
    timer.o (+RO)
  }
  RW_IRAM1 0x20000000 0x00020000  {
  
   ;.ANY (+RW +ZI)
  }
  RW_IRAM2 0x30020000 0x00020000  { ;已经用作lwip heap了 ，勿再使用
  
   *(lwip_heap)
  }
  RW_IRAM3 0x24000000 0x00080000  {  ; RW data
   .ANY (+RW +ZI)
   ;.ANY (HEAP)
   *(axi_ram)  ;起一个新setion名字 lvgl的缓冲 buf_1 buf_2定位到此
  }

  ARM_LIB_HEAP  0xC1000000 UNINIT 0x1000000 { ; 

	.ANY (HEAP)                                        
  }
}


  
LR_IROM2 0x90000000 0x00800000  {
  ER_IROM2 0x90000000 0x00800000  {  ; load address = execution address
	i2s.o (+RO)
    dma.o (+RO)
    dma2d.o (+RO)
    ltdc.o (+RO)
    sai.o (+RO)
    sdmmc.o (+RO)
    stm32h7xx_hal_eth_ex.o (+RO)
    stm32h7xx_hal_eth.o (+RO)
    stm32h7xx_hal_hsem.o (+RO)
    stm32h7xx_hal_dma.o (+RO)
    stm32h7xx_hal_dma_ex.o (+RO)
    stm32h7xx_hal_mdma.o (+RO)
    stm32h7xx_hal_i2c.o (+RO)
    stm32h7xx_hal_i2c_ex.o (+RO)
    stm32h7xx_hal_exti.o (+RO)
    stm32h7xx_hal_dma2d.o (+RO)
    stm32h7xx_hal_ltdc.o (+RO)
    stm32h7xx_hal_ltdc_ex.o (+RO)
    stm32h7xx_hal_sai.o (+RO)
    stm32h7xx_hal_sai_ex.o (+RO)
    stm32h7xx_ll_sdmmc.o (+RO)
    stm32h7xx_ll_delayblock.o (+RO)
    stm32h7xx_hal_sd.o (+RO)
    stm32h7xx_hal_sd_ex.o (+RO)
    stm32h7xx_hal_tim.o (+RO)
    stm32h7xx_hal_tim_ex.o (+RO)
    stm32h7xx_hal_i2s.o (+RO)
    stm32h7xx_hal_i2s_ex.o (+RO)
    gt9147.o (+RO)
    ctiic.o (+RO)
    MusicDecode.o (+RO)
    img_benchmark_cogwheel_alpha16.o (+RO)
    img_benchmark_cogwheel_argb.o (+RO)
    img_benchmark_cogwheel_chroma_keyed.o (+RO)
    img_benchmark_cogwheel_indexed16.o (+RO)
    img_benchmark_cogwheel_rgb.o (+RO)
    lv_demo_benchmark.o (+RO)
    lv_font_montserrat_12_compr_az.o (+RO)
    lv_font_montserrat_16_compr_az.o (+RO)
    lv_font_montserrat_28_compr_az.o (+RO)
    lv_demo_keypad_encoder.o (+RO)
    lv_demo_widgets.o (+RO)
    img_clothes.o (+RO)
    img_demo_widgets_avatar.o (+RO)
    img_lvgl_logo.o (+RO)
    lv_font.o (+RO)
    lv_font_dejavu_16_persian_hebrew.o (+RO)
    lv_font_fmt_txt.o (+RO)
    lv_font_loader.o (+RO)
    lv_font_montserrat_8.o (+RO)
    lv_font_montserrat_10.o (+RO)
    lv_font_montserrat_12.o (+RO)
    lv_font_montserrat_12_subpx.o (+RO)
    lv_font_montserrat_14.o (+RO)
    lv_font_montserrat_16.o (+RO)
    lv_font_montserrat_18.o (+RO)
    lv_font_montserrat_20.o (+RO)
    lv_font_montserrat_22.o (+RO)
    lv_font_montserrat_24.o (+RO)
    lv_font_montserrat_26.o (+RO)
    lv_font_montserrat_28.o (+RO)
    lv_font_montserrat_28_compressed.o (+RO)
    lv_font_montserrat_30.o (+RO)
    lv_font_montserrat_32.o (+RO)
    lv_font_montserrat_34.o (+RO)
    lv_font_montserrat_36.o (+RO)
    lv_font_montserrat_38.o (+RO)
    lv_font_montserrat_40.o (+RO)
    lv_font_montserrat_42.o (+RO)
    lv_font_montserrat_44.o (+RO)
    lv_font_montserrat_46.o (+RO)
    lv_font_montserrat_48.o (+RO)
    lv_font_simsun_16_cjk.o (+RO)
    lv_font_unscii_8.o (+RO)
    lv_font_unscii_16.o (+RO)
    lv_gpu_stm32_dma2d.o (+RO)
    gifdec.o (+RO)
    lv_gif.o (+RO)
    LvglBsp.o (+RO)
    about.o (+RO)
    background.o (+RO)
    delet.o (+RO)
    image.o (+RO)
    mail.o (+RO)
    pos.o (+RO)
    ExternFont.o (+RO)
    MyGuiDemo.o (+RO)
    ffsystem.o (+RO)
    ffunicode.o (+RO)
    diskio.o (+RO)
    ff.o (+RO)
    ff_gen_drv.o (+RO)
    lwip.o (+RO)
    lan8742.o (+RO)
    ethernet.o (+RO)
    api_lib.o (+RO)
    api_msg.o (+RO)
    err.o (+RO)
    if_api.o (+RO)
    netbuf.o (+RO)
    netdb.o (+RO)
    netifapi.o (+RO)
    sockets.o (+RO)
    tcpip.o (+RO)
    altcp.o (+RO)
    altcp_alloc.o (+RO)
    altcp_tcp.o (+RO)
    def.o (+RO)
    dns.o (+RO)
    inet_chksum.o (+RO)
    init.o (+RO)
    ip.o (+RO)
    mem.o (+RO)
    memp.o (+RO)
    netif.o (+RO)
    pbuf.o (+RO)
    raw.o (+RO)
    stats.o (+RO)
    sys.o (+RO)
    tcp.o (+RO)
    tcp_in.o (+RO)
    tcp_out.o (+RO)
    timeouts.o (+RO)
    udp.o (+RO)
    autoip.o (+RO)
    dhcp.o (+RO)
    etharp.o (+RO)
    icmp.o (+RO)
    igmp.o (+RO)
    ip4.o (+RO)
    ip4_addr.o (+RO)
    ip4_frag.o (+RO)
    mld6.o (+RO)
    sys_arch.o (+RO)
    mqtt.o (+RO)   
  }
}
