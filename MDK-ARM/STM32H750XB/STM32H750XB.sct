; *************************************************************
; *** Scatter-Loading Description File generated by uVision ***
; *************************************************************

LR_IROM1 0x08000000 0x00100000  {    ; load region size_region
  ER_IROM1 0x08000000 0x00100000  {  ; load address = execution address
   *.o (RESET, +First)
   *(InRoot$$Sections)
   .ANY (+RO)
   .ANY (+XO)
  }
  RW_IRAM2 0x24000000 0x00080000  {  ; RW data
   .ANY (+RW +ZI)
  }
  RW_IRAM1 0x20000000 0x00020000  {
    lv_color.o (+RO)
    lv_math.o (+RO)
    lv_timer.o (+RO)
  }
  ARM_LIB_HEAP  0xC1000000 UNINIT 0x1000000 { ; 

	.ANY (HEAP)                                        
  }
}

LR_IROM2 0x90000000 0x00800000  {
  ER_IROM2 0x90000000 0x00800000  {  ; load address = execution address
    ltdc.o (+RO)
    sai.o (+RO)
    sdmmc.o (+RO)
    stm32h7xx_hal_dma2d.o (+RO)
    stm32h7xx_hal_dma.o (+RO)
    stm32h7xx_hal_dma_ex.o (+RO)
    stm32h7xx_hal_mdma.o (+RO)
    stm32h7xx_hal_i2c.o (+RO)
    stm32h7xx_hal_i2c_ex.o (+RO)
    stm32h7xx_ll_fmc.o (+RO)
    stm32h7xx_hal_sdram.o (+RO)
    stm32h7xx_hal_ltdc.o (+RO)
    stm32h7xx_hal_ltdc_ex.o (+RO)
    stm32h7xx_hal_sai.o (+RO)
    stm32h7xx_hal_sai_ex.o (+RO)
    stm32h7xx_ll_sdmmc.o (+RO)
    stm32h7xx_hal_sd.o (+RO)
    stm32h7xx_hal_sd_ex.o (+RO)
    gt9147.o (+RO)
    ctiic.o (+RO)
    MusicDecode.o (+RO)
    img_benchmark_cogwheel_alpha16.o (+RO)
    img_benchmark_cogwheel_argb.o (+RO)
    img_benchmark_cogwheel_chroma_keyed.o (+RO)
    img_benchmark_cogwheel_indexed16.o (+RO)
    img_benchmark_cogwheel_rgb.o (+RO)
    lv_demo_benchmark.o (+RO)
    lv_font_montserrat_12_compr_az.o (+RO)
    lv_font_montserrat_16_compr_az.o (+RO)
    lv_font_montserrat_28_compr_az.o (+RO)
    lv_demo_keypad_encoder.o (+RO)
    lv_demo_widgets.o (+RO)
    img_clothes.o (+RO)
    img_demo_widgets_avatar.o (+RO)
    img_lvgl_logo.o (+RO)
    lv_disp.o (+RO)
    lv_event.o (+RO)
    lv_group.o (+RO)
    lv_indev.o (+RO)
    lv_indev_scroll.o (+RO)
    lv_obj.o (+RO)
    lv_obj_class.o (+RO)
    lv_obj_draw.o (+RO)
    lv_obj_pos.o (+RO)
    lv_obj_scroll.o (+RO)
    lv_obj_style.o (+RO)
    lv_obj_style_gen.o (+RO)
    lv_obj_tree.o (+RO)
    lv_refr.o (+RO)
    lv_theme.o (+RO)
    lv_draw_arc.o (+RO)
    lv_draw_blend.o (+RO)
    lv_draw_img.o (+RO)
    lv_draw_label.o (+RO)
    lv_draw_line.o (+RO)
    lv_draw_mask.o (+RO)
    lv_draw_rect.o (+RO)
    lv_draw_triangle.o (+RO)
    lv_img_buf.o (+RO)
    lv_img_cache.o (+RO)
    lv_img_decoder.o (+RO)
    lv_flex.o (+RO)
    lv_grid.o (+RO)
    lv_snapshot.o (+RO)
    lv_theme_basic.o (+RO)
    lv_theme_default.o (+RO)
    lv_theme_mono.o (+RO)
    lv_animimg.o (+RO)
    lv_calendar.o (+RO)
    lv_calendar_header_arrow.o (+RO)
    lv_calendar_header_dropdown.o (+RO)
    lv_chart.o (+RO)
    lv_colorwheel.o (+RO)
    lv_imgbtn.o (+RO)
    lv_keyboard.o (+RO)
    lv_led.o (+RO)
    lv_list.o (+RO)
    lv_meter.o (+RO)
    lv_msgbox.o (+RO)
    lv_span.o (+RO)
    lv_spinbox.o (+RO)
    lv_spinner.o (+RO)
    lv_tabview.o (+RO)
    lv_tileview.o (+RO)
    lv_win.o (+RO)
    lv_extra.o (+RO)
    lv_font.o (+RO)
    lv_font_dejavu_16_persian_hebrew.o (+RO)
    lv_font_fmt_txt.o (+RO)
    lv_font_loader.o (+RO)
    lv_font_montserrat_8.o (+RO)
    lv_font_montserrat_10.o (+RO)
    lv_font_montserrat_12.o (+RO)
    lv_font_montserrat_12_subpx.o (+RO)
    lv_font_montserrat_14.o (+RO)
    lv_font_montserrat_16.o (+RO)
    lv_font_montserrat_18.o (+RO)
    lv_font_montserrat_20.o (+RO)
    lv_font_montserrat_22.o (+RO)
    lv_font_montserrat_24.o (+RO)
    lv_font_montserrat_26.o (+RO)
    lv_font_montserrat_28.o (+RO)
    lv_font_montserrat_28_compressed.o (+RO)
    lv_font_montserrat_30.o (+RO)
    lv_font_montserrat_32.o (+RO)
    lv_font_montserrat_34.o (+RO)
    lv_font_montserrat_36.o (+RO)
    lv_font_montserrat_38.o (+RO)
    lv_font_montserrat_40.o (+RO)
    lv_font_montserrat_42.o (+RO)
    lv_font_montserrat_44.o (+RO)
    lv_font_montserrat_46.o (+RO)
    lv_font_montserrat_48.o (+RO)
    lv_font_simsun_16_cjk.o (+RO)
    lv_font_unscii_8.o (+RO)
    lv_font_unscii_16.o (+RO)
    lv_gpu_stm32_dma2d.o (+RO)
    lv_hal_disp.o (+RO)
    lv_hal_indev.o (+RO)
    lv_hal_tick.o (+RO)
    lv_anim.o (+RO)
    lv_anim_timeline.o (+RO)
    lv_area.o (+RO)
    lv_async.o (+RO)
    lv_bidi.o (+RO)
    lv_fs.o (+RO)
    lv_gc.o (+RO)
    lv_ll.o (+RO)
    lv_log.o (+RO)
    lv_mem.o (+RO)
    lv_printf.o (+RO)
    lv_style.o (+RO)
    lv_style_gen.o (+RO)
    lv_templ.o (+RO)
    lv_tlsf.o (+RO)
    lv_txt.o (+RO)
    lv_txt_ap.o (+RO)
    lv_utils.o (+RO)
    lv_arc.o (+RO)
    lv_bar.o (+RO)
    lv_btn.o (+RO)
    lv_btnmatrix.o (+RO)
    lv_canvas.o (+RO)
    lv_checkbox.o (+RO)
    lv_dropdown.o (+RO)
    lv_img.o (+RO)
    lv_label.o (+RO)
    lv_line.o (+RO)
    lv_objx_templ.o (+RO)
    lv_roller.o (+RO)
    lv_slider.o (+RO)
    lv_switch.o (+RO)
    lv_table.o (+RO)
    lv_textarea.o (+RO)
    lodepng.o (+RO)
    lv_png.o (+RO)
    gifdec.o (+RO)
    lv_gif.o (+RO)
    LvglBsp.o (+RO)
    MyGuiDemo.o (+RO)
    about.o (+RO)
    background.o (+RO)
    delet.o (+RO)
    image.o (+RO)
    mail.o (+RO)
    pos.o (+RO)
    ExternFont.o (+RO)
    fatfs.o (+RO)
    diskio.o (+RO)
    ff_gen_drv.o (+RO)
    ffsystem.o (+RO)
    ffunicode.o (+RO)
    mem.o (+RO)
  }
}
